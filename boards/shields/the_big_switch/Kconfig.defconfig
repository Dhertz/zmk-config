## boards/shields/the_big_switch/Kconfig.defconfig
```kconfig
# Copyright (c) 2022 The ZMK Contributors
# SPDX-License-Identifier: MIT

if SHIELD_THE_BIG_SWITCH

config ZMK_KEYBOARD_NAME
    default "The Big Switch"

endif
```

## boards/shields/the_big_switch/Kconfig.shield
```kconfig
# Copyright (c) 2022 The ZMK Contributors
# SPDX-License-Identifier: MIT

config SHIELD_THE_BIG_SWITCH
    def_bool $(shields_list_contains,the_big_switch)
```
